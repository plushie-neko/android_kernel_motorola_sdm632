/* Copyright (c) 2018, The Linux Foundation. All rights reserved.
 *
 * This program is free software; you can redistribute it and/or modify
 * it under the terms of the GNU General Public License version 2 and
 * only version 2 as published by the Free Software Foundation.
 *
 * This program is distributed in the hope that it will be useful,
 * but WITHOUT ANY WARRANTY; without even the implied warranty of
 * MERCHANTABILITY or FITNESS FOR A PARTICULAR PURPOSE.  See the
 * GNU General Public License for more details.
 */

/dts-v1/;

#include "sdm632-moto-base.dtsi"

/ {
	model = "MTP S3 K81822AA1";
	compatible = "qcom,sdm632-mtp", "qcom,sdm632", "qcom,mtp";
	qcom,msm-id = <0x15d 0x00>;
	qcom,board-id = <0x08 0x00>;
	qcom,pmic-id = <0x10016 0x25 0x00 0x00>;
};

#include "m1822/sdm632-m1822.dtsi"
